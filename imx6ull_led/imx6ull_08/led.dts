    leds{
        compatible = "myled,zpq";
		pinctrl-names = "default";
		pinctrl-0 = <&pinctrl_leds>;
		led-gpios = <&gpio5 3 GPIO_ACTIVE_LOW>;
       
    };
	
	pinctrl_leds:ledgrp {        
			fsl,pins = <
				MX6ULL_PAD_SNVS_TAMPER3__GPIO5_IO03        0x000110A0
			>;
    };

	leds {
		compatible = "gpio-leds";
		pinctrl-names = "default";
		pinctrl-0 = <&pinctrl_leds>;

		status = "disabled";

		led0: cpu {
			label = "cpu";
			gpios = <&gpio5 3 GPIO_ACTIVE_LOW>;
			default-state = "on";
			linux,default-trigger = "heartbeat";
		};
    };

	 /*pin = <GROUP_PIN(3, 1)>;*/
	/*test_led@1{
			compatible = "myled,zpq";
			pin = <GROUP_PIN(5, 8)>;
	};*/